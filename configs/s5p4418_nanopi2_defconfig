## configs/s5p4418_nanopi2_defconfig
```kconfig
CONFIG_ARM=y
CONFIG_ARCH_NEXELL=y
CONFIG_ARCH_S5P4418=y
CONFIG_TARGET_NANOPI2=y
CONFIG_NR_DRAM_BANKS=1
CONFIG_DEFAULT_DEVICE_TREE="s5p4418-nanopi2"
CONFIG_SYS_TEXT_BASE=0x74C00000
CONFIG_ENV_IS_IN_MMC=y
CONFIG_ENV_OFFSET=0x2E0200
CONFIG_ENV_SIZE=0x4000
CONFIG_BOOTDELAY=2
CONFIG_CONS_INDEX=0
CONFIG_BLK=y
CONFIG_DOS_PARTITION=y
CONFIG_SUPPORT_RAW_INITRD=y
CONFIG_FS_FAT=y
CONFIG_FS_EXT4=y
CONFIG_FAT_WRITE=y
CONFIG_EXT4_WRITE=y
CONFIG_SYS_DCACHE_OFF=y
CONFIG_CFB_CONSOLE=y
#CONFIG_CFB_CONSOLE_ANSI=y
CONFIG_FIT=y
CONFIG_SYS_PROMPT="nanopi2 > "
CONFIG_HUSH_PARSER=y
CONFIG_SYS_PROMPT_HUSH_PS2="> "
CONFIG_CMD_I2C=y
CONFIG_CMD_USB=y
CONFIG_CMD_GPIO=y
CONFIG_CMD_GPT=y
CONFIG_CMD_IMI=y
CONFIG_CMD_BOOTZ=y
CONFIG_CMD_MEMTEST=y
# CONFIG_CMD_FPGA is not set
# CONFIG_CMD_IMLS is not set
# CONFIG_CMD_FLASH is not set
# CONFIG_CMD_SETEXPR is not set
# CONFIG_CMD_NET is not set
# CONFIG_CMD_NFS is not set
CONFIG_CMD_FDISK=y
CONFIG_CMD_EXT4_IMG_WRITE=y
CONFIG_CMD_SD_RECOVERY=y
CONFIG_CMD_PMIC=y
CONFIG_CMD_REGULATOR=y
CONFIG_CMD_FAT=y
CONFIG_CMD_MMC=y
CONFIG_CMD_EXT4=y
CONFIG_CMD_EXT4_WRITE=y
CONFIG_OF_CONTROL=y
CONFIG_OF_SEPARATE=y
CONFIG_OF_LIBFDT=y
CONFIG_FIT_BEST_MATCH=y
CONFIG_OF_BOARD_SETUP=y
CONFIG_DM=y
CONFIG_DM_I2C=y
CONFIG_DM_I2C_GPIO=y
CONFIG_SYS_I2C_NEXELL=y
CONFIG_DM_GPIO=y
CONFIG_NX_GPIO=y
CONFIG_DM_PMIC=y
CONFIG_DM_PMIC_AXP228=y
CONFIG_DM_REGULATOR=y
CONFIG_DM_REGULATOR_AXP228=y
CONFIG_DM_PWM=y
CONFIG_DM_USB=y
CONFIG_DM_MMC=y
CONFIG_MMC=y
CONFIG_MMC_DW=y
CONFIG_DISPLAY=y
CONFIG_VIDEO=y
CONFIG_VIDEO_NX=y
CONFIG_VIDEO_NX_RGB=y
CONFIG_VIDEO_NX_LVDS=y
CONFIG_VIDEO_NX_HDMI=y
CONFIG_REGEX=y
CONFIG_ERRNO_STR=y
CONFIG_USB=y
CONFIG_USB_EHCI_HCD=y
CONFIG_USB_STORAGE=y
CONFIG_USB_GADGET=y
CONFIG_USB_GADGET_VBUS_DRAW=0
CONFIG_USB_GADGET_MANUFACTURER="Nexell Corporation"
CONFIG_USB_GADGET_VENDOR_NUM=0x18d1
CONFIG_USB_GADGET_PRODUCT_NUM=0x0002
CONFIG_USB_GADGET_DOWNLOAD=y
CONFIG_USB_GADGET_DWC2_OTG=y
CONFIG_USB_GADGET_DUALSPEED=y
CONFIG_USB_FUNCTION_FASTBOOT=y
CONFIG_FASTBOOT_FLASH=y
CONFIG_FASTBOOT_FLASH_MMC_DEV=0
CONFIG_FASTBOOT_BUF_ADDR=0x7B000000
CONFIG_FASTBOOT_BUF_SIZE=0x12000000

CONFIG_LOG=y
CONFIG_MAX_LOG_LEVEL=7
CONFIG_LOG_CONSOLE=y
```
